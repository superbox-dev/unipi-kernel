/dts-v1/;

/ {

	fragment@0 {
		target = <0xffffffff>;

		__overlay__ {
			#address-cells = <0x01>;
			#size-cells = <0x00>;
			status = "okay";

			mcp7940x@6f {
				compatible = "unipi,rtc-unipi";
				reg = <0x6f>;
				status = "okay";
			};
		};
	};

	__fixups__ {
		i2c1 = "/fragment@0:target:0";
	};
};
