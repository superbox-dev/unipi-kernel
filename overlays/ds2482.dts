/dts-v1/;

/ {

	fragment@0 {
		target = <0xffffffff>;

		__overlay__ {
			#address-cells = <0x01>;
			#size-cells = <0x00>;
			status = "okay";

			ds2482@18 {
				compatible = "ds2482";
				reg = <0x18>;
				status = "okay";
				phandle = <0x01>;
			};
		};
	};

	__symbols__ {
		ds2482 = "/fragment@0/__overlay__/ds2482@18";
	};

	__fixups__ {
		i2c1 = "/fragment@0:target:0";
	};
};
