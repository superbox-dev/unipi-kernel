/dts-v1/;

/ {

	fragment@0 {
		target = <0xffffffff>;

		__overlay__ {
			#address-cells = <0x01>;
			#size-cells = <0x00>;
			status = "okay";

			24c01@57 {
				compatible = "atmel,24c01";
				reg = <0x57>;
				status = "okay";
				phandle = <0x01>;
			};
		};
	};

	fragment@1 {
		target-path = "/";

		__overlay__ {

			unipi-id {
				compatible = "unipi,unipi-id";
				nvmem = <0x01>;
				nvmem-names = "plcid0";
				id-channel = <0xffffffff>;
				phandle = <0x02>;
			};
		};
	};

	__symbols__ {
		unipi_mb = "/fragment@0/__overlay__/24c01@57";
		unipi_id = "/fragment@1/__overlay__/unipi-id";
	};

	__fixups__ {
		i2c1 = "/fragment@0:target:0\0/fragment@1/__overlay__/unipi-id:id-channel:0";
	};

	__local_fixups__ {

		fragment@1 {

			__overlay__ {

				unipi-id {
					nvmem = <0x00>;
				};
			};
		};
	};
};
